## esp/weather/main/Kconfig.projbuild
```kconfig
menu "Weather application configuration"

    menu "WIFI Configuration"
        config WIFI_SSID
            string "WIFI SSID"
            default "SSID"
            help
                "Enter the SSID of the WIFI network you want to connect to."
            
        config WIFI_PASSWORD
            string "WIFI Password"
            default "PASSWORD"
            help
                "Enter the password of the WIFI network you want to connect to."
    endmenu

    menu "I2C Configuration"
        config I2C_SDA
            int "I2C SDA Pin"
            default 21
            help
                "Enter the GPIO pin number for the I2C SDA line."
            
        config I2C_SCL
            int "I2C SCL Pin"
            default 22
            help
                "Enter the GPIO pin number for the I2C SCL line."
        
        config I2C_MASTER_PORT_NUM
            int "I2C Master Port Number"
            default 0
            help
                "Enter the I2C master port number."
        
        config I2C_MASTER_FREQUENCY
            int "I2C Master Frequency"
            default 400000
            help
                "Enter the I2C master frequency."
        
        config  I2C_MASTER_TIMEOUT_MS
            int "I2C Master Timeout (ms)"
            default 1000
            help
                "Enter the I2C master timeout in milliseconds."
    endmenu

    menu "ADC configuration"
        
        config A_VBAT_CHANNEL
            int "A_VBAT ESP32 channel"
            default 0
            help
                ADC Channel number for A_VBAT
        
        config A_IGNIT_CONT_1_CHANNEL
            int "A_IGNIT_CONT_1 ESP32 channel"
            default 6
            help
                ADC Channel number for A_IGNIT_CONT_1

        config A_IGNIT_CONT_2_CHANNEL
            int "A_IGNIT_CONT_2 ESP32 channel"
            default 7
            help
                ADC Channel number for A_IGNIT_CONT_2

    endmenu

endmenu
```
